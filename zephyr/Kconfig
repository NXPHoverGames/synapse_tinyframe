## zephyr/Kconfig
```kconfig
# SPDX-License-Identifier: Apache-2.0
config SYNAPSE_TINYFRAME
        bool "Synapse TinyFrame Support"
        help
          This option enables the Synapse Tinyframe library.

if SYNAPSE_TINYFRAME

endif
```
